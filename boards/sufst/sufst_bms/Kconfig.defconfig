## boards/sufst/sufst_bms/Kconfig.defconfig
```kconfig
# SPDX-License-Identifier: Apache-2.0

if BOARD_SUFST_BMS

config SPI_STM32_INTERRUPT
	default y
	depends on SPI

endif # BOARD_SUFST_BMS
```

## boards/sufst/sufst_bms/Kconfig.sufst_bms
```kconfig
# SPDX-License-Identifier: Apache-2.0

config BOARD_SUFST_BMS
	select SOC_STM32G474XX
```

## boards/sufst/sufst_bms/board.yml
```yaml
board:
  name: sufst_bms
  full_name: SUFST BMS Custom PCB (STM32G474CEU6)
  vendor: sufst
  socs:
    - name: stm32g474xx
```
